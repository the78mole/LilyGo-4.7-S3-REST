## main/Kconfig.projbuild
```kconfig
menu "LilyGo T5-4.7 S3 Application"

    menu "Wi-Fi"
        config APP_WIFI_SSID
            string "Wi-Fi SSID"
            default "myssid"
            help
                STA-mode network the device joins on boot.

        config APP_WIFI_PASSWORD
            string "Wi-Fi Password"
            default "mypassword"
            help
                Leave empty for an open network.

        config APP_WIFI_MAX_RETRY
            int "Max connection retries before giving up"
            default 10
    endmenu

    menu "HTTP Server"
        config APP_HTTP_PORT
            int "REST API TCP port"
            default 80

        config APP_HTTP_MAX_UPLOAD_BYTES
            int "Maximum accepted /api/upload body size (bytes)"
            default 16777216
            help
                Guards against filling the SD card / exhausting an
                attacker-controlled Content-Length. 16 MiB default.
    endmenu

    menu "SD Card (SPI)"
        config APP_SD_MOUNT_POINT
            string "VFS mount point"
            default "/sdcard"

        config APP_SD_PIN_MISO
            int "SD MISO GPIO"
            default 16
            help
                Defaults taken from LilyGo-EPD47 src/utilities.h
                (CONFIG_IDF_TARGET_ESP32S3 branch), i.e. the 2021-6-10 / V2.3
                PCB this project targets. Note these differ completely from
                the later "S3 Pro" board (which uses 21/13/14/12) -- on V2.3,
                GPIO21 is BUTTON_1, not SD CS.

        config APP_SD_PIN_MOSI
            int "SD MOSI GPIO"
            default 15

        config APP_SD_PIN_SCLK
            int "SD SCLK GPIO"
            default 11

        config APP_SD_PIN_CS
            int "SD CS GPIO"
            default 42

        config APP_SD_SPI_HOST
            int "SPI host number for the SD card"
            default 1
            help
                SPI2_HOST = 1, SPI3_HOST = 2 on ESP32-S3. The EPD panel
                uses its own SPI-like parallel interface via epdiy and
                does not share this bus.
    endmenu

    menu "Time / Chart"
        config APP_NTP_SERVER
            string "NTP server"
            default "pool.ntp.org"
            help
                Used to establish local time so charts can highlight the slot
                that is current right now. The client only supplies data
                points, never the highlight index.

        config APP_TIMEZONE
            string "POSIX TZ string"
            default "CET-1CEST,M3.5.0,M10.5.0/3"
            help
                Default is Europe/Berlin incl. DST. Note the inverted sign
                convention: CET-1 means UTC+1.

        config APP_CHART_Y_MAX
            int "Chart y-axis maximum (ct/kWh)"
            default 60
            help
                The y axis is fixed at 0..this value rather than auto-scaled,
                so charts stay comparable between days.

                This is a DECISION THRESHOLD, not a display range: above it
                you should not be starting a dishwasher or planning to bake
                bread anyway, so the exact height of an outlier carries no
                information worth screen space. Values above are clamped and
                flagged with a marker; the current-price readout in the title
                bar still reports the true figure.

                Do not "fix" clipped bars by raising this -- clipping is the
                intended behaviour. Raise it only if the threshold at which
                you change your own behaviour actually changes.

        config APP_CHART_Y_MIN_NEG
            int "Chart y-axis floor when prices go negative (ct/kWh)"
            default -10
            range -100 0
            help
                Only used when the plotted data actually contains negative
                values; otherwise the axis stays at 0 so the full plot height
                serves the range that normally matters.

                Capped for the same reason as the ceiling: negative prices
                have been as low as -49 ct/kWh, but once they are negative at
                all the answer is "switch everything on", and how far below
                zero they go changes nothing. Bars beyond this floor are
                clamped and flagged with a marker.

        config APP_CHART_INTERVAL_MIN
            int "Minutes per chart slot"
            default 15
            help
                15 -> 96 slots per day, matching quarter-hourly dynamic
                electricity tariffs.

        config APP_CHART_MARGIN
            int "Dashboard cell margin (px)"
            default 10
    endmenu

    menu "Public Transport (VGN EFA)"
        # Defaults mirror the reference implementation in
        # the78mole/Playground/vgn-abfahrten/vgn_abfahrten.py, including its
        # tag strings. Note entries 1 and 2 are the same stop and line in
        # opposite directions -- which is exactly why the label exists.
        config APP_DEP1_STOP
            string "Departure 1: EFA stop id"
            default "3003410"
            help
                3003410 = Bruck (Erlangen), Bahnhof.
        config APP_DEP1_LINE
            string "Departure 1: line number"
            default "S1"
        config APP_DEP1_DIR
            string "Departure 1: EFA direction code (H/R)"
            default "H"
            help
                Matched against servingLine.liErgRiProj.direction. More stable
                than the displayed destination, which varies with short
                workings (Lauf, Hartmannshof, ... all being "towards
                Nuremberg").
        config APP_DEP1_LABEL
            string "Departure 1: badge label"
            default "S1-NBG"

        config APP_DEP2_STOP
            string "Departure 2: EFA stop id"
            default "3003410"
        config APP_DEP2_LINE
            string "Departure 2: line number"
            default "S1"
        config APP_DEP2_DIR
            string "Departure 2: EFA direction code (H/R)"
            default "R"
        config APP_DEP2_LABEL
            string "Departure 2: badge label"
            default "S1-BBG"

        config APP_DEP3_STOP
            string "Departure 3: EFA stop id"
            default "3003463"
            help
                3003463 = Bruck (Erlangen), Bachfeldstr.
        config APP_DEP3_LINE
            string "Departure 3: line number"
            default "285"
        config APP_DEP3_DIR
            string "Departure 3: EFA direction code (H/R)"
            default "H"
        config APP_DEP3_LABEL
            string "Departure 3: badge label"
            default "285"

        config APP_DEP_REFRESH_S
            int "Refresh interval (seconds)"
            default 120
            help
                The device polls EFA itself, so departures stay current
                between dashboard pushes.
    endmenu

    menu "RTOS Task Placement"
        config APP_TASK_CORE_NETWORK
            int "Core for Wi-Fi / HTTP server tasks"
            default 0
            help
                PRO_CPU. Keeps networking off the core driving the panel.

        config APP_TASK_CORE_DISPLAY
            int "Core for LVGL / epdiy tasks"
            default 1
            help
                APP_CPU. Isolates the timing-sensitive EPD refresh loop.

        config APP_LVGL_TASK_STACK
            int "LVGL task stack size (bytes)"
            default 8192

        config APP_LVGL_TASK_PRIORITY
            int "LVGL task priority"
            default 4

        config APP_FULL_REFRESH_EVERY
            int "Force a full panel refresh after this many partial updates"
            default 30
            help
                Partial updates are fast but leave faint residue. With a
                one-minute strip update that is a full clean-up every half
                hour.

        config APP_LVGL_TICK_PERIOD_MS
            int "LVGL tick period (ms)"
            default 5

        config APP_LVGL_HANDLER_PERIOD_MS
            int "lv_timer_handler() poll period (ms)"
            default 20
    endmenu

endmenu
```
